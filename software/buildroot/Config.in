## software/buildroot/Config.in
```kconfig
source "$BR2_EXTERNAL/package/interlock/Config.in"
source "$BR2_EXTERNAL/package/electrum/Config.in"
```

## software/buildroot/package/dnspython/Config.in
```kconfig
config BR2_PACKAGE_DNSPYTHON
        bool "dnspython"
        help
          dnspython is a DNS toolkit for Python
          http://www.dnspython.org/
```

## software/buildroot/package/electrum/Config.in
```kconfig
config BR2_PACKAGE_ELECTRUM
        bool "electrum"
        help
          A thin bitcoin client

          http://electrum.org
```

## software/buildroot/package/python-jsonrpclib/Config.in
```kconfig
config BR2_PACKAGE_PYTHON_JSONRPCLIB
        bool "python-jsonrpclib"
        help
          json rpc library for python
```

## software/buildroot/package/python-pbkdf2/Config.in
```kconfig
config BR2_PACKAGE_PYTHON_PBKDF2
        bool "python-pbkdf2"
        help
          This module implements the password-based key derivation function, PBKDF2
          http://www.dlitz.net/software/python-pbkdf2/
```

## software/buildroot/package/python-pillow/Config.in
```kconfig
config BR2_PACKAGE_PYTHON_PILLOW
        bool "python-pillow"
        help
          Graphic processing library for python
```

## software/buildroot/package/python-qrcode/Config.in
```kconfig
config BR2_PACKAGE_PYTHON_QRCODE
        bool "python-qrcode"
        select BR2_PACKAGE_PYTHON_PILLOW
        help
          qrcode generation for python
```

## software/buildroot/package/python-slowaes/Config.in
```kconfig
config BR2_PACKAGE_PYTHON_SLOWAES
    bool "python-slowaes"
    help
      Implementations of AES in pure scripting languages (currently !Javascript,
      Python, Ruby, and PHP, but, in addition to further contributions in those
      languages, submissions in other scripting languages are also entirely
      welcome!).

      Such implementations will be slow (hence the project name) but still
      useful when faster ones are not available (for example, for JavaScript
      clients in browsers, and Python servers on Google App Engine).

      https://code.google.com/p/slowaes/
```
